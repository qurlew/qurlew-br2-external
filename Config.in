## package/qurlew/Config.in
```kconfig
config BR2_PACKAGE_QURLEW
	bool "qurlew"
	depends on BR2_PACKAGE_QT5WEBENGINE
	select BR2_PACKAGE_NETCAT_OPENBSD
	help
	  Fullscreen QtWebEngine browser picking URLs from stdin.
```
